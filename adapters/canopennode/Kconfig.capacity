## examples/probe_idf/main/Kconfig.projbuild
```kconfig
menu "MotorControl-CAN example"
config MOTORCONTROLCAN_COMPILE_FIXTURE
    bool "Compile-only fixture: keep CAN disabled"
    default y
    help
        This build fixture establishes no actual board, transceiver or bus.
        Disabling it requires explicit verified controller configuration below.
config MOTORCONTROLCAN_CAN_TX_PIN
    int "CAN TX GPIO (-1 unknown)"
    default -1
    range -1 48
config MOTORCONTROLCAN_CAN_RX_PIN
    int "CAN RX GPIO (-1 unknown)"
    default -1
    range -1 48
config MOTORCONTROLCAN_CAN_BITRATE
    int "CAN bitrate (0 unknown)"
    default 0
    range 0 1000000
config MOTORCONTROLCAN_CAN_RX_DEPTH
    int "Copied controller RX capacity"
    default 16
    range 1 16
config MOTORCONTROLCAN_CAN_SILENT_PIN
    int "Transceiver silent-input GPIO (-1 none)"
    default -1
    range -1 48
    help
        Application-owned GPIO wired to the transceiver's silent/standby input.
        Startup requests the silent level before anything else; only an explicit
        start requests the normal level.
config MOTORCONTROLCAN_CAN_SILENT_LEVEL
    int "Level that makes the transceiver silent (-1 unknown/none)"
    default -1
    range -1 1
    help
        Board fact from the transceiver datasheet and schematic, never a default.
        A silent pin with level -1 fails compilation.
config MOTORCONTROLCAN_SMOKE_HOOK
    bool "Test-only finite smoke check on the owner task"
    default n
    help
        Builds FirmwareSmoke: one 'G' byte on the console arms one explicit start
        and one identity read on each of two nodes. Not a console or CLI.
config MOTORCONTROLCAN_SMOKE_NODE_A
    int "Smoke check first CANopen node (0 unknown)"
    depends on MOTORCONTROLCAN_SMOKE_HOOK
    default 0
    range 0 127
config MOTORCONTROLCAN_SMOKE_NODE_B
    int "Smoke check second CANopen node (0 unknown)"
    depends on MOTORCONTROLCAN_SMOKE_HOOK
    default 0
    range 0 127
config MOTORCONTROLCAN_SMOKE_IDENTITY_U8
    bool "Fixture answers 1009/100A in one byte (measured, not EDS)"
    depends on MOTORCONTROLCAN_SMOKE_HOOK
    default n
endmenu
```

## examples/probe_idf/sdkconfig.defaults
```kconfig
CONFIG_IDF_TARGET="esp32s3"
CONFIG_MOTORCONTROLCAN_COMPILE_FIXTURE=y
CONFIG_FREERTOS_HZ=1000
CONFIG_ESPTOOLPY_FLASHSIZE_8MB=y
CONFIG_ESP_CONSOLE_NONE=y
CONFIG_BOOTLOADER_LOG_LEVEL_NONE=y
CONFIG_LOG_DEFAULT_LEVEL_NONE=y
# CONFIG_PM_ENABLE is not set
# CONFIG_TWAI_ISR_CACHE_SAFE is not set
# CONFIG_TWAI_ISR_IN_IRAM is not set
# CONFIG_FREERTOS_SMP is not set
# CONFIG_SPIRAM is not set
```

## test/twai_sdk_compile/sdkconfig.defaults
```kconfig
CONFIG_IDF_TARGET="esp32s3"
# CONFIG_PM_ENABLE is not set
# CONFIG_TWAI_ISR_CACHE_SAFE is not set
# CONFIG_TWAI_ISR_IN_IRAM is not set
# CONFIG_FREERTOS_SMP is not set
```
